## arch/x86/cpu/uefi/Kconfig
```kconfig
if TARGET_UEFI

config SYS_UEFI
	bool
	default y

config UEFIMEM_CONSOLE
	bool
	default y

config VIDEO_UEFI
	bool
	default y

endif
```

## board/uefi/Kconfig
```kconfig
if VENDOR_UEFI

choice
	prompt "Mainboard model"
	optional

config TARGET_UEFI
	bool "uefi"
	help
	  This target is used for running U-Boot on top of UEFI. In
	  this case UEFI does the early inititalization, and U-Boot
	  takes over once the RAM, video and CPU are fully running.
	  U-Boot is loaded as an application from UEFI.

endchoice

source "board/uefi/uefi/Kconfig"

endif
```

## board/uefi/uefi/Kconfig
```kconfig
if TARGET_UEFI

config SYS_BOARD
	default "uefi"

config SYS_VENDOR
	default "uefi"

config SYS_SOC
	default "uefi"

comment "uefi-specific options"

config SYS_CONFIG_NAME
	string "Board configuration file"
	default "uefi-x86"
	help
	  This option selects the board configuration file in include/configs/
	  directory to be used to build U-Boot for UEFI.

endif
```

## configs/BSC9131RDB_SPIFLASH_defconfig
```kconfig
CONFIG_PPC=y
CONFIG_MPC85xx=y
CONFIG_TARGET_BSC9131RDB=y
CONFIG_SYS_EXTRA_OPTIONS="BSC9131RDB,SPIFLASH"
# CONFIG_CMD_IMLS is not set
# CONFIG_CMD_FLASH is not set
CONFIG_MTD_SPI_NOR=y
CONFIG_MTD_M25P80=y
CONFIG_SPI_NOR_SPANSION=y
CONFIG_SYS_NS16550=y
CONFIG_FSL_ESPI=y
```

## configs/C29XPCIE_defconfig
```kconfig
CONFIG_PPC=y
CONFIG_MPC85xx=y
CONFIG_TARGET_C29XPCIE=y
CONFIG_SYS_EXTRA_OPTIONS="C29XPCIE,36BIT"
CONFIG_MTD_SPI_NOR=y
CONFIG_MTD_M25P80=y
CONFIG_SPI_NOR_MISC=y
CONFIG_SPI_NOR_SPANSION=y
CONFIG_NETDEVICES=y
CONFIG_E1000=y
CONFIG_SYS_NS16550=y
CONFIG_FSL_ESPI=y
```

## configs/P4080DS_defconfig
```kconfig
CONFIG_PPC=y
CONFIG_MPC85xx=y
CONFIG_TARGET_P4080DS=y
CONFIG_MTD_SPI_NOR=y
CONFIG_MTD_M25P80=y
CONFIG_SPI_NOR_SPANSION=y
CONFIG_NETDEVICES=y
CONFIG_E1000=y
CONFIG_SYS_NS16550=y
CONFIG_FSL_ESPI=y
```

## configs/T1024RDB_defconfig
```kconfig
CONFIG_PPC=y
CONFIG_MPC85xx=y
CONFIG_TARGET_T102XRDB=y
CONFIG_SYS_EXTRA_OPTIONS="PPC_T1024,T1024RDB"
CONFIG_MTD_SPI_NOR=y
CONFIG_MTD_M25P80=y
CONFIG_SPI_NOR_STMICRO=y
CONFIG_NETDEVICES=y
CONFIG_E1000=y
CONFIG_SYS_NS16550=y
CONFIG_FSL_ESPI=y
```

## configs/T1042RDB_PI_defconfig
```kconfig
CONFIG_PPC=y
CONFIG_MPC85xx=y
CONFIG_TARGET_T104XRDB=y
CONFIG_SYS_EXTRA_OPTIONS="PPC_T1042,T1042RDB_PI"
CONFIG_MTD_SPI_NOR=y
CONFIG_MTD_M25P80=y
CONFIG_SPI_FLASH_STMICRO=y
CONFIG_NETDEVICES=y
CONFIG_E1000=y
CONFIG_SYS_NS16550=y
CONFIG_FSL_ESPI=y
```

## configs/T2080RDB_SPIFLASH_defconfig
```kconfig
CONFIG_PPC=y
CONFIG_MPC85xx=y
CONFIG_TARGET_T208XRDB=y
CONFIG_SPL=y
CONFIG_SYS_EXTRA_OPTIONS="PPC_T2080,RAMBOOT_PBL,SPL_FSL_PBL,SPIFLASH"
CONFIG_MTD_SPI_NOR=y
CONFIG_MTD_M25P80=y
CONFIG_SPI_NOR_STMICRO=y
CONFIG_NETDEVICES=y
CONFIG_E1000=y
CONFIG_SYS_NS16550=y
CONFIG_FSL_ESPI=y
```

## configs/T4160QDS_SECURE_BOOT_defconfig
```kconfig
CONFIG_PPC=y
CONFIG_MPC85xx=y
CONFIG_TARGET_T4240QDS=y
CONFIG_SYS_EXTRA_OPTIONS="PPC_T4160,SECURE_BOOT"
CONFIG_MTD_SPI_NOR=y
CONFIG_MTD_M25P80=y
CONFIG_SPI_FLASH_SST=y
CONFIG_NETDEVICES=y
CONFIG_E1000=y
CONFIG_SYS_NS16550=y
CONFIG_FSL_ESPI=y
```

## configs/T4240RDB_SDCARD_defconfig
```kconfig
CONFIG_PPC=y
CONFIG_MPC85xx=y
CONFIG_TARGET_T4240RDB=y
CONFIG_SPL=y
CONFIG_SYS_EXTRA_OPTIONS="PPC_T4240,RAMBOOT_PBL,SPL_FSL_PBL,SDCARD"
CONFIG_MTD_SPI_NOR=y
CONFIG_MTD_M25P80=y
CONFIG_SPI_NOR_SST=y
CONFIG_NETDEVICES=y
CONFIG_E1000=y
CONFIG_SYS_NS16550=y
CONFIG_FSL_ESPI=y
```

## configs/kmcoge4_defconfig
```kconfig
CONFIG_PPC=y
CONFIG_MPC85xx=y
CONFIG_TARGET_KMP204X=y
CONFIG_SYS_EXTRA_OPTIONS="KMCOGE4"
# CONFIG_CMD_IMLS is not set
# CONFIG_CMD_FLASH is not set
CONFIG_MTD_SPI_NOR=y
CONFIG_MTD_M25P80=y
CONFIG_SPI_FLASH_SPANSION=y
CONFIG_SPI_FLASH_STMICRO=y
CONFIG_NETDEVICES=y
CONFIG_E1000=y
CONFIG_SYS_NS16550=y
CONFIG_FSL_ESPI=y
```

## configs/uefi-x86_defconfig
```kconfig
CONFIG_X86=y
CONFIG_CMD_NET=y
CONFIG_VENDOR_UEFI=y
CONFIG_TARGET_UEFI=y
CONFIG_TSC_CALIBRATION_BYPASS=y
CONFIG_OF_CONTROL=y
CONFIG_DM_PCI=y
CONFIG_DEFAULT_DEVICE_TREE="planetbde"
```

## configs/xpedite520x_defconfig
```kconfig
CONFIG_PPC=y
CONFIG_MPC85xx=y
CONFIG_TARGET_XPEDITE520X=y
CONFIG_FIT=y
CONFIG_OF_BOARD_SETUP=y
# CONFIG_CMD_SETEXPR is not set
CONFIG_SYS_NS16550=y
CONFIG_OF_LIBFDT=y
```
